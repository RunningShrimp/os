/* Generic bootloader linker script */

ENTRY(_start)

SECTIONS {
    . = 0x10000;  /* Bootloader typically at 64KB */
    
    .text : {
        KEEP(*(.text.boot))
        *(.text .text.*)
    }
    
    .rodata : {
        *(.rodata .rodata.*)
    }
    
    .data : {
        *(.data .data.*)
    }
    
    .bss : {
        __bss_start = .;
        *(.bss .bss.*)
        *(COMMON)
        __bss_end = .;
    }
    
    /DISCARD/ : {
        *(.note .note.*)
        *(.comment)
    }
}
