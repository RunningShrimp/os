/* RISC-V 64 bootloader linker script */

ENTRY(_start)

SECTIONS {
    . = 0x80000000;  /* RISC-V typical boot address (2GB) */
    
    .text : {
        KEEP(*(.text.boot))
        *(.text .text.*)
    }
    
    .rodata : {
        *(.rodata .rodata.*)
    }
    
    .data : {
        *(.data .data.*)
    }
    
    .bss : {
        __bss_start = .;
        *(.bss .bss.*)
        *(COMMON)
        __bss_end = .;
    }
}
